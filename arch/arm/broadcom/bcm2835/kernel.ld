/* the entry point is _start */
ENTRY(_start)

SECTIONS
{
	/* link the kernel at 3GB */
	. = 0xc0000000;

	.text ALIGN(4K) : AT(ADDR(.text) + 0x8000 - 0xc0000000)
	{
		__kernel_v_start = .;
		__kernel_p_start = LOADADDR(.text);
		/* put the .text.boot section first */
		KEEP(*(.text.boot))
		*(.text)
	}

	/* read-only data. */
	.rodata ALIGN(4K) : AT(ADDR(.rodata) + 0x8000 - 0xc0000000)
	{
		*(.rodata)
	}

	/* read-write data (initialized) */
	.data ALIGN(4K) : AT(ADDR(.data) + 0x8000 - 0xc0000000)
	{
		*(.data)
	}

	/* read-write data (uninitialized) */
	.bss ALIGN(4K) : AT(ADDR(.bss) + 0x8000 - 0xc0000000)
	{
		__bss_start = LOADADDR(.bss);
		*(COMMON)
		*(.bss)
	}
	. = ALIGN(4K);
	__bss_end = . + 0x8000 - 0xc0000000;

	__kernel_v_end = .;
	__kernel_p_end = . + 0x8000 - 0xc0000000;

	/* discard other sections generated by the compiler */
	/DISCARD/ :
	{
		*(.note*)
		*(.indent)
		*(.comment)
		*(.stab)
		*(.stabstr)
		*(.ARM.*)
	}
}
