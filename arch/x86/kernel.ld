/* the entry point is _start */
ENTRY(_start)

SECTIONS
{
	/*
	 * VMA:
	 * the kernel will live at 0xc0100000 (3GB + 1MB) in virtual memory
	 * the 1st MB of physical memory (hardware map) will be mapped to 0xc0000000
	 */
	. = 0xc0100000;


	/*
	 * sections LMA: load AT VMA - 0xc0000000 (i.e. starting at 1M)
	 */

	.text ALIGN(4K) : AT(ADDR(.text) - 0xc0000000)
	{
		__kernel_v_start = .;
		__kernel_p_start = . - 0xc0000000;
		/* put the multiboot header first, then the .text section */
		*(.multiboot)
		*(.text)
	}

	/* read-only data. */
	.rodata ALIGN(4K) : AT(ADDR(.rodata) - 0xc0000000)
	{
		*(.rodata)
	}

	/* read-write data (initialized) */
	.data ALIGN(4K) : AT(ADDR(.data) - 0xc0000000)
	{
		*(.data)
	}

	/* read-write data (uninitialized) */
	.bss ALIGN(4K) : AT(ADDR(.bss) - 0xc0000000)
	{
		*(COMMON)
		*(.bss)

	}

	/* align the end symbols upward to a 4 byte boundary */
	__kernel_v_end = (. + 3) & ~ 3;
	__kernel_p_end = __kernel_v_end - 0xc0000000;

	/* discard other sections generated by the compiler */
	/DISCARD/ :
	{
		*(.note*)
		*(.indent)
		*(.comment)
		*(.stab)
		*(.stabstr)
	}
}
